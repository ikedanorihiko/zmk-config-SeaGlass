## config/west.yml
```yaml
manifest:
  remotes:
    - name: zmkfirmware
      url-base: https://github.com/zmkfirmware
    - name: inorichi
      url-base: https://github.com/inorichi
    - name: caksoylar
      url-base: https://github.com/caksoylar
    - name: 4mplelab
      url-base: https://github.com/4mplelab

    - name: prospector
      url-base: https://github.com/t-ogura

    - name: razilyis
      url-base: https://github.com/razilyis
      
  projects:
    - name: zmk
      remote: zmkfirmware
      revision: v0.3
      import: app/west.yml
 #   - name: zmk-pmw3610-driver
 #     remote: inorichi
 #     revision: main
    - name: zmk-rgbled-widget
      remote: caksoylar
      revision: v0.3-branch
    - name: zmk-feature-charge-indicator
      remote: 4mplelab
      revision: main

    - name: zmk-pmw3610-driver
      remote: razilyis
      revision: Dev-v0.3_inertial-scroll


# Add this:
    - name: prospector-zmk-module
      remote: prospector
      revision: v2.2.1
      
  self:
    path: config

    path: modules/prospector-zmk-module
```
